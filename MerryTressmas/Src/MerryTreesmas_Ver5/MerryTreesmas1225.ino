 
/*
그래픽 LCD:

마그네틱 센서: 2번핀 활용(디지털 값)

조도센서: 8번핀 활용(아날로그값 360기준 밤)

온, 습도센서

사운드센서
->아날로그 1번핀

피에조
디지털(5번핀)
삭제 할 부분??
-->온습도 변수 chk 삭제해도 될듯, case문도 같이

-->변수 uiKeyCodeSecond 아무데서도 안씀

->>시리얼 부분
*/      
#include "U8glib.h" //그래픽lcd 헤더파일


#include "dht11.h"  //조도센서 헤더파일
dht11 DHT;          //객체 생성
#define DHT11_PIN 4 //4번핀에 온습도센서


U8GLIB_NHD_C12864 u8g(13, 11, 10, 9, 8);      // SPI Com: SCK = 13, MOSI = 11, CS = 10, A0 = 9, RST = 8

#define MENU_ITEMS 4  //처음 보일 메뉴 크기
char *menu_strings[MENU_ITEMS] = { "Hello World", "manual", "Start Game", "exit" };     //메뉴 이름들

uint8_t menu_current = 0;//메뉴 상태

int count_cold=0;            //bin의 상태변화를 위한 카운트
int count_happy=0;

#define KEY_NONE 0           //키설정
#define KEY_PREV 1
#define KEY_NEXT 2
#define KEY_SELECT 3
#define KEY_BACK 4
uint8_t uiKeyCodeFirst = KEY_NONE;
uint8_t uiKeyCodeSecond = KEY_NONE;
uint8_t uiKeyCode = KEY_NONE;   //실질적인 키값 부분

int numTones=128;//numTones이라는 배열 수를 나타내는 변수 
int tones[]={261, 440, 392, 349, 261, 0, 0, 0, 261, 440, 392, 349, 294, 0, 0, 0,
294, 467, 440, 392, 330, 0, 0, 0, 523, 523, 467, 392, 440, 0, 349, 0,
261, 440, 392, 349, 261, 0, 0, 0, 261, 440, 392, 349, 294, 0, 0, 0,
294, 467, 440, 392, 523, 0, 523, 523, 587, 523, 467, 392, 349, 0, 0, 0,
440, 440, 440, 0, 440, 440, 440, 0, 440, 523, 349, 392, 440, 0, 0, 0,
467, 467, 467, 467, 467, 440, 440, 440, 440, 392, 392, 349, 392, 0, 523, 0,
440, 440, 440, 0, 440, 440, 440, 0, 440, 523, 349, 392, 440, 0, 0, 0,
467, 467, 467, 467, 467, 440, 440, 440, 523, 523, 467, 392, 349, 0, 0, 0};//피에조 음


int piezo=5;//피에조 부저는 5번 핀으로 설정
int inputMagnet = 2;         // 마그네틱센서 핀
int val = 0;   
int valSound = 0;                 
int action = 0;          // 메뉴 제어 변수
int chk;                 // 값을 읽고 에러 검출부분
int light;               // 조도
int x =  100;             // 캐릭터 움직임
int y =  50;             // 캐릭터 움직임
bool isEnd = false;     //과정에서 움직이는 것으로 변하게 하는 변수
bool the_end = false;   //해피빈이 나무로 변하게 하는 변수
bool present = false;     // 사운드 감지해서 ;ㅁ;ㅇ리ㅏ;ㅁㄴ

int adc_key_in;
int key=-1;
int oldkey=-1;
int draw_state=0;
int draw_state2=0;
// 키 값
//         4
//         |
//   0 --  1 -- 3
//         |
//         2

//
//            prev
//               |
//   back -- select -- none
//               |
//             next
int get_key(unsigned int input)
{   
  if (input < 100) return 0;          //왼쪽
  else  if (input < 300) return 1;    //클릭
  else  if (input < 500) return 2;    //아래
  else  if (input < 700) return 3;   //오른쪽
  else  if (input < 900) return 4;   //위
  else  return -1;                  //예외
}

void uiStep(void) {//키를 입력받고 uiKeyCode에 저장
  adc_key_in = analogRead(0);   // 키값을 읽음
  key = get_key(adc_key_in);   // key에 저장(return값으로)
  Serial.print(key);
  if (key != oldkey)            // 한번씩만 눌리도록 함
  {
    delay(10);   
    oldkey = key;             //한번씩만 눌리도록 함
    if (key >=0){
      //Serial.println(key);
      if ( key == 0 )
        uiKeyCodeFirst = KEY_BACK;
      else if ( key == 1 )
        uiKeyCodeFirst = KEY_SELECT;
      else if ( key == 2 )
        uiKeyCodeFirst = KEY_NEXT;
      else if ( key == 4 )
        uiKeyCodeFirst = KEY_PREV;
      else 
        uiKeyCodeFirst = KEY_NONE;

      uiKeyCode = uiKeyCodeFirst;           
    }
  }
  delay(100);
}

void uiStep2(void) {            // 여러번 움직일수 있게함 if (왼쪽 쭉하면 계속 이동)

  adc_key_in = analogRead(0);    
  key = get_key(adc_key_in);   
  if (key >=0){
    //Serial.println(key);
    if ( key == 0 )
      uiKeyCodeFirst = KEY_BACK;
    else if ( key == 1 )
      uiKeyCodeFirst = KEY_SELECT;
    else if ( key == 2 )
      uiKeyCodeFirst = KEY_NEXT;
    else if ( key == 4 )
      uiKeyCodeFirst = KEY_PREV;
    else 
      uiKeyCodeFirst = KEY_NONE;

    uiKeyCode = uiKeyCodeFirst;           
  }
  delay(100);
}

void drawMenu(void) {           //메뉴를 그리는 함수
  uint8_t i, h;
  u8g_uint_t w, d;

  u8g.setFont(u8g_font_6x12);//4x6 5x7 5x8 6x10 6x12 6x13
  u8g.setFontRefHeightText();
  u8g.setFontPosTop();

  h = u8g.getFontAscent()-u8g.getFontDescent();
  w = u8g.getWidth();
  for( i = 0; i < MENU_ITEMS; i++ ) {
    d = (w-u8g.getStrWidth(menu_strings[i]))/2;
    u8g.setDefaultForegroundColor();
    if ( i == menu_current ) {  
      u8g.drawBox(0, i*h+1, w, h);
      u8g.setDefaultBackgroundColor();
    }
    u8g.drawStr(d, i*h+1, menu_strings[i]);
  }
}


void movement(void){             //키를 입력받았을때 물체가 움직이도록하는 함수
  switch( uiKeyCode ){  
     case KEY_PREV:
     if(y>0)
       y--;
       break;
     case KEY_NEXT:
     if(y<50)
       y++;
       break;
     case KEY_BACK:
     if(x>60)
       x--; 
       break;
     case KEY_NONE:
     if(x<110)
       x++;
       break;
  }
  uiKeyCode=-1;
}

void reset(void){             //키를 입력받았을때 물체가 움직이도록하는 함수
  switch( uiKeyCode ){  
     case KEY_SELECT:
     action=0;
      the_end = false;
       break;
  }
  uiKeyCode=-1;
}


void escape(void) {             //키를 입력받았을때 왼쪽 버튼을 누르면 탈출 함수(메뉴 부분에만 적용)
  switch( uiKeyCode ){
  case KEY_BACK:
    action=0;
    break;
  }
}

void print_menual(void){        //메뉴얼 출력함수
  u8g_prepare();
  u8g.drawStr( 5, 0, "how to play");
  u8g.drawStr( 5, 10, "bin react to temp");
  u8g.drawStr( 5, 20, "bin eat magnet");
  u8g.drawStr( 5, 30, "if bin is full");
  u8g.drawStr( 5, 40, "bin can be tree");
  u8g.drawStr( 5, 50, "Have Fun this");
}

void updateMenu(void)          //키의 입력에 따라 menu_current를 바꿔 표시된 부분에 대비가 되도록 함
{
  switch ( uiKeyCode ) {
  case KEY_NEXT:
    menu_current++;
    if ( menu_current >= MENU_ITEMS )menu_current = 0;
    break;
  case KEY_PREV:
    if ( menu_current == 0 )menu_current = MENU_ITEMS;
    menu_current--;
    break;
  case KEY_SELECT:
    if(menu_current!=0)
      action=1;
    break;
  }
  uiKeyCode = KEY_NONE;
}

void u8g_prepare(void) {        //글자 폰트 조절
  u8g.setFont(u8g_font_6x10);////4x6 5x7 5x8 6x10 6x12 6x13
  u8g.setFontRefHeightExtendedText();
  u8g.setDefaultForegroundColor();
  u8g.setFontPosTop();
}

void u8g_prepare2(void) {         //글자 폰트 조절(더 작게한 버전)
  u8g.setFont(u8g_font_5x7);
  u8g.setFontRefHeightExtendedText();
  u8g.setDefaultForegroundColor();
  u8g.setFontPosTop();
}
const uint8_t bitmap_Sun[] PROGMEM = {    //해
  0x00,0x10,0x10,0x00,
  0x00,0x18,0x30,0x00,
  0x00,0x18,0x30,0x00,
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  0x00,0x00,0x08,0x00
};
const uint8_t bitmap_Moon[] PROGMEM = {   //달
  0x00,0x00,0x00,0x00,
  0x00,0x00,0x06,0x00,
  0x00,0x00,0x03,0x80,
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  0x00,0x0f,0xf8,0x00
};
const uint8_t rook_bitmap3[] PROGMEM = {      //해피콩
  0x00,0x00,0x00,0x00,0x00,
  0x00,0x00,0x00,0x00,0x00,
  0x00,0x00,0x00,0x00,0x00,
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  0x00,0x00,0x00,0x00,0x00
};
const uint8_t rook_bitmap6[] PROGMEM = {      //해피콩 좋아2
  0x00,0x00,0x00,0x00,0x00,
  0x00,0x00,0x00,0x00,0x00,
  0x00,0x00,0x00,0x00,0x00,
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  0x00,0x00,0x00,0x00,0x00
};
const uint8_t rook_bitmap4[] PROGMEM = {      //해피콩추워1 ㅠ
  0x00,0x00,0x00,0x00,0x00,
  0x00,0x00,0x00,0x00,0x00,
  0x00,0x00,0x00,0x00,0x00,
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  0x00,0x00,0x00,0x00,0x00
};
const uint8_t rook_bitmap5[] PROGMEM = {        //해피콩추워2 ㅠ
  0x00,0x00,0x00,0x00,0x00,
  0x00,0x00,0x00,0x00,0x00,
  0x00,0x00,0x00,0x00,0x00,
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  0x00,0x00,0x00,0x00,0x00
};
const uint8_t rook_bitmap7[] PROGMEM = {      //해피콩 더워2 ㅠ
  0x00,0x00,0x00,0x01,0xf8,
  0x00,0x00,0x00,0x03,0x0c,
  0x00,0x00,0x00,0x02,0x04,
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  0x00,0x00,0x00,0x00,0x00
};

const uint8_t bitmap_Tree[] PROGMEM = {       //완전체!!(나무)
  0x00,0x00,0x18,0x00,0x00,
  0x00,0x00,0x18,0x00,0x00,
  0x00,0x10,0xdb,0x00,0x00,
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  0x00,0x00,0x18,0x00,0x00
};

const uint8_t bitmap_Logo1[] PROGMEM = {              //LJH-HEJ 크리스마스!!!
  0x00,0x00,0x00,0x00,0x00,0x00,0x00,0x00,0x00,0x00,0x00,0x00,0x00,0x00,0x00,0x00,
  0x00,0x00,0x00,0x00,0x00,0x00,0x00,0x00,0x00,0x00,0x00,0x00,0x00,0x00,0x00,0x00,
  0x00,0x00,0x00,0x00,0x00,0x00,0x00,0x00,0x00,0x00,0x00,0x00,0x00,0x00,0x00,0x00,
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  0x00,0x00,0x00,0x00,0x00,0x00,0x00,0x00,0x00,0x00,0x00,0x00,0x00,0x00,0x00,0x00
};

const uint8_t bitmap_Logo2[] PROGMEM = {              //LJH-HEJ 크리스마스2!!!
  0xff,0xff,0xff,0xff,0xff,0xff,0xff,0xff,0xff,0xff,0xff,0xff,0xff,0xff,0xff,0xff,
  0xff,0xff,0xff,0xff,0xff,0xff,0xff,0xff,0xff,0xff,0xff,0xff,0xff,0xff,0xff,0xff,
  0xff,0xff,0xff,0xff,0xff,0xff,0xff,0xff,0xff,0xff,0xff,0xff,0xff,0xff,0xff,0xff,
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  0xff,0xff,0xff,0xff,0xff,0xff,0xff,0xff,0xff,0xff,0xff,0xff,0xff,0xff,0xff,0xff
};
const uint8_t bitmap_child[] PROGMEM = {              //닝겐
0x0f,0xf0,
0x10,0x08,
0x14,0x88,
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0x12,0x48
};
void Tree_state(){                    //빈이 자라기 전 상태출력함수
  u8g_prepare2();

  if(light>400){                      //밤인지 낮인지
    u8g.drawBitmapP( 95, 0, 4, 25, bitmap_Moon);
  }
  else
    u8g.drawBitmapP( 100, 0, 4, 25, bitmap_Sun);

  u8g.drawStr( 0, 0, "Hum");          //습도
  u8g.setPrintPos(20,0);
  u8g.print(DHT.humidity);
  u8g.drawStr( 30, 0, "%");           

  u8g.drawStr( 0, 10, "Temp");       //온도
  u8g.setPrintPos(20,10);
  u8g.print(DHT.temperature);
  u8g.drawStr( 30, 10, "C");



  if(DHT.temperature>27){           //온도에 따른 상태
    u8g.drawStr( 0, 20, "Hot!!");
  }
  else if(DHT.temperature<25){
    u8g.drawStr( 0, 20, "Cold..");
  }
  else
    u8g.drawStr( 0, 20, "Happy..");


  if(count_cold>80)
    count_cold=0;

  if(DHT.temperature<25){
    if(count_cold<40)
      u8g.drawBitmapP( 40, 12, 5, 54, rook_bitmap4);
    else if(count_cold<80)
      u8g.drawBitmapP( 40, 12, 5, 54, rook_bitmap5);
    count_cold++;
  }
  else if(DHT.temperature>27)
    u8g.drawBitmapP( 40, 12, 5, 54, rook_bitmap7);
  else{
    if(count_happy>80)
      count_happy=0;
    if( count_happy<40)
      u8g.drawBitmapP( 40, 12, 5, 54, rook_bitmap3);
    else if(count_happy<80)
      u8g.drawBitmapP( 40, 12, 5, 54, rook_bitmap6);
    count_happy++;
  }
  delay(10);
}

void draw_food(void) {            //진화 과정!!!!
  u8g_prepare();
  switch(draw_state >> 3) {
  case 0: eat(); break;
  case 1: eat2(); break;
  case 2: eat3(); break;
  case 3: eat4(); break;
  case 4: eat5(); break;
  case 5: TreesMas(); break;
  //case 6: logo1(); break;
 // case 7: logo2(); break;
  }
}
void draw_logo(void) {            //진화 과정!!!!
  u8g_prepare();
  switch(draw_state2%2) {

  case 0: logo1(); break;
  case 1: logo2(); break;
  }
}
void eat(void){
  u8g.drawStr( 5, 20, "bin eat magnet");
  delay(50);
}
void eat2(void){
  u8g.drawStr( 5, 20, "...........");
  delay(3);
}
void eat3(void){
  u8g.drawStr( 5, 20, "almost done.");
  delay(5);
}
void eat4(void){
  u8g.drawStr( 5, 20, "almost done...");
  delay(5);
}
void eat5(void){
  u8g.drawStr( 5, 20, "almost done.....");
  delay(5);
}
void TreesMas(){
  u8g.drawBitmapP( 20, 12, 5, 55, bitmap_Tree);
  delay(30); // 약 5~6초
}
void logo1(){
  u8g.drawBitmapP( 0, 0, 16, 64, bitmap_Logo1);
}
void logo2(){
  u8g.drawBitmapP( 0, 0, 16, 64, bitmap_Logo2);
}



void setup() {

  Serial.begin(9600);
  pinMode(piezo,OUTPUT);//피에저부조가 연결된 핀을 output으로 설정
  pinMode(inputMagnet, INPUT);     // 마그네틱 센서를 인풋으로 설정해놓음(디지털값)
  switch (chk){
  case DHTLIB_OK:  
    Serial.print("OK,\t"); 
    break;
  case DHTLIB_ERROR_CHECKSUM: 
    Serial.print("Checksum error,\t"); 
    break;
  case DHTLIB_ERROR_TIMEOUT: 
    Serial.print("Time out error,\t"); 
    break;
  default: 
    Serial.print("Unknown error,\t"); 
    break;
  }  
  u8g.setRot180();          // 보기 편하게 180도 회전
  u8g.setContrast(0);       // 보기 편하게 대비
}

void loop() {  

  chk = DHT.read(DHT11_PIN);        //센서 인식 부분
  light=analogRead(8);              //조도의 값을 받음
  val = digitalRead(inputMagnet);      //마그네틱의 값을 받음
                                    // 마그네틱이 작동 됬다면
  valSound = analogRead(1);         // 사운드센서 값을 받음
  
  if((val==HIGH&&(25<=DHT.temperature&&DHT.temperature<=27))||the_end){
    the_end=true;
    u8g.firstPage();
    if(isEnd == false){ 
         do {
           draw_food();                    //진화를 시작함
        } while( u8g.nextPage() );
        draw_state++;
        if ( draw_state >= 8*6 ){
           draw_state = 0;
           isEnd = true;                 //화면 전환을 위한 bool변수
        }
    }
    else{                             //우리가 조작 가능하게 구현

      if( present == false ){
           uiStep2();
           movement();
           u8g.firstPage();
             do  {
                u8g.drawBitmapP( 20, 12 , 5, 55, bitmap_Tree);
                u8g.drawBitmapP( x, y, 2, 16, bitmap_child);  //원하는 그림을 조작 가능
             } while( u8g.nextPage() );
      }
      
      if(  x > 50 && x < 70  && y > 40  && valSound > 60 || present ){
          uiStep2();
          reset();
          u8g.firstPage();
          present = true;
      do  {
          draw_logo();
      } while( u8g.nextPage() );
         draw_state2++;
           delay(100);   
          // 피에조
       for(int i=0; i<numTones; i++){
       if(tones[i]==0){
   //     noTone(piezo);
       }
       else
        tone(piezo,tones[i]); 
       delay(80); 
      uiStep2();
      reset();
       noTone(piezo); 
       }
        uiStep2();
        reset();
        delay(100);
      }
    }
  }
  if(the_end == false ){              //마그네틱이 작동 안했을때(the_end는 마그네틱이 작동해야 true로 변함)
    if(action==0 ){                  //클릭이 들어오지 않았을때는
      uiStep();                                
      updateMenu();                            
      u8g.firstPage();
      do  {
        drawMenu();                   //메뉴를 출력함
      } while( u8g.nextPage() );
    }
    if(action==1&&menu_current==1){   //첫번째 메뉴얼에서 클릭하면
      uiStep();                               
      escape();
      u8g.firstPage();  
      do {
        print_menual();                //메뉴얼을 출력
      } while( u8g.nextPage() );
    }

    if(action==1&&menu_current==2){     //두번째 메뉴얼에서 클릭하면
      uiStep();                              
      escape();
      u8g.firstPage();  
      do {
        Tree_state();                 //해피빈과의 교류
      } while( u8g.nextPage() );
    }
    if(action==1&&menu_current==3){     //세번째 메뉴얼에서 클릭하면
      uiStep();                               
      escape();
      u8g.firstPage();  
      do {
        u8g_prepare();
        u8g.drawStr( 10, 20, "thank you to play");    //thank you구문 출력

      } while( u8g.nextPage() );
    }
  }
}
