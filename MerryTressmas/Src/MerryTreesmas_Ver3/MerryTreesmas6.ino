
#include "U8glib.h"
// setup u8g object, please remove comment from one of the following constructor calls
// IMPORTANT NOTE: The complete list of supported devices is here: http://code.google.com/p/u8glib/wiki/device

//조도센서헤더파일
#include "dht11.h"
dht11 DHT;
#define DHT11_PIN 4


U8GLIB_NHD_C12864 u8g(13, 11, 10, 9, 8);  // SPI Com: SCK = 13, MOSI = 11, CS = 10, A0 = 9, RST = 8

#define KEY_NONE 0
#define KEY_PREV 1
#define KEY_NEXT 2
#define KEY_SELECT 3
#define KEY_BACK 4
int inputPin = 2;               // choose the input pin  
int val = 0;                    // variable for reading the pin status
int action=0;
int chk;
int light;
uint8_t uiKeyCodeFirst = KEY_NONE;
uint8_t uiKeyCodeSecond = KEY_NONE;
uint8_t uiKeyCode = KEY_NONE;

int adc_key_in;
int key=-1;
int oldkey=-1;
int draw_state=0;

// Convert ADC value to key number
//         4
//         |
//   0 --  1 -- 3
//         |
//         2

//-->180도 회전하면
//            prev(1)
//               |
//   back(4) -- select(3) -- none(0)
//               |
//             next(2)
int get_key(unsigned int input)
{   
    if (input < 100) return 0;//오른쪽
    else  if (input < 300) return 1;//위
    else  if (input < 500) return 2;//아래
    else  if (input < 700) return 3;//중앙
    else  if (input < 900) return 4; //왼쪽
    else  return -1;//나머지
}

void uiStep(void) {
  
  adc_key_in = analogRead(0);    // read the value from the sensor  
  key = get_key(adc_key_in);   // convert into key press  
  Serial.print(key);
  if (key != oldkey)    // if keypress is detected
   {
    delay(10);    // wait for debounce time
      oldkey = key;
      if (key >=0){
             //Serial.println(key);
             if ( key == 0 )
               uiKeyCodeFirst = KEY_BACK;
             else if ( key == 1 )
               uiKeyCodeFirst = KEY_SELECT;
             else if ( key == 2 )
               uiKeyCodeFirst = KEY_NEXT;
             else if ( key == 4 )
               uiKeyCodeFirst = KEY_PREV;
             else 
               uiKeyCodeFirst = KEY_NONE;
  
             uiKeyCode = uiKeyCodeFirst;           
    }
  }
 delay(100);
}


#define MENU_ITEMS 4
char *menu_strings[MENU_ITEMS] = { "Hello World", "manual", "Start Game", "exit" };

uint8_t menu_current = 0;
int count_cold=0;
int count_happy=0;

void drawMenu(void) {
  uint8_t i, h;
  u8g_uint_t w, d;

  u8g.setFont(u8g_font_6x12);//4x6 5x7 5x8 6x10 6x12 6x13
  u8g.setFontRefHeightText();
  u8g.setFontPosTop();
  
  h = u8g.getFontAscent()-u8g.getFontDescent();
  w = u8g.getWidth();
  for( i = 0; i < MENU_ITEMS; i++ ) {
    d = (w-u8g.getStrWidth(menu_strings[i]))/2;
    u8g.setDefaultForegroundColor();
    if ( i == menu_current ) {  
      u8g.drawBox(0, i*h+1, w, h);
      u8g.setDefaultBackgroundColor();
    }
    u8g.drawStr(d, i*h+1, menu_strings[i]);
  }
}
void escape(void) {
  switch( uiKeyCode ){
  case KEY_BACK:
  action=0;
  break;
  }
}
void print_menual(void){
   u8g_prepare();
   u8g.drawStr( 5, 0, "how to play");
   u8g.drawStr( 5, 10, "bin react to temp");
   u8g.drawStr( 5, 20, "bin eat magnet");
   u8g.drawStr( 5, 30, "if bin is full, can be tree");
   u8g.drawStr( 5, 40, "Have Fun this");
}
void updateMenu(void) 
{
  switch ( uiKeyCode ) {
    case KEY_NEXT:
      menu_current++;
      if ( menu_current >= MENU_ITEMS )menu_current = 0;
      break;
    case KEY_PREV:
      if ( menu_current == 0 )menu_current = MENU_ITEMS;
      menu_current--;
      break;
    case KEY_SELECT:
    if(menu_current!=0)
      action=1;
    break;
  }
  uiKeyCode = KEY_NONE;
}
void u8g_prepare(void) {
  u8g.setFont(u8g_font_6x10);
  u8g.setFontRefHeightExtendedText();
  u8g.setDefaultForegroundColor();
  u8g.setFontPosTop();
}
void u8g_prepare2(void) {
  u8g.setFont(u8g_font_5x7);
  u8g.setFontRefHeightExtendedText();
  u8g.setDefaultForegroundColor();
  u8g.setFontPosTop();
}
const uint8_t rook_bitmap[] PROGMEM = {//해
0x00,0x10,0x10,0x00,
0x00,0x18,0x30,0x00,
0x00,0x18,0x30,0x00,
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0x00,0x00,0x08,0x00
};
const uint8_t rook_bitmap2[] PROGMEM = {//달
0x00,0x00,0x00,0x00,
0x00,0x00,0x06,0x00,
0x00,0x00,0x03,0x80,
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0x00,0x0f,0xf8,0x00
};
const uint8_t rook_bitmap3[] PROGMEM = {//해피콩
0x00,0x00,0x00,0x00,0x00,
0x00,0x00,0x00,0x00,0x00,
0x00,0x00,0x00,0x00,0x00,
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0x00,0x00,0x00,0x00,0x00
};
const uint8_t rook_bitmap6[] PROGMEM = {//해피콩 좋아2
0x00,0x00,0x00,0x00,0x00,
0x00,0x00,0x00,0x00,0x00,
0x00,0x00,0x00,0x00,0x00,
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0x00,0x00,0x00,0x00,0x00
};
const uint8_t rook_bitmap4[] PROGMEM = {//해피콩추워1 ㅠ
0x00,0x00,0x00,0x00,0x00,
0x00,0x00,0x00,0x00,0x00,
0x00,0x00,0x00,0x00,0x00,
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0x00,0x00,0x00,0x00,0x00
};
const uint8_t rook_bitmap5[] PROGMEM = {//해피콩추워2 ㅠ
0x00,0x00,0x00,0x00,0x00,
0x00,0x00,0x00,0x00,0x00,
0x00,0x00,0x00,0x00,0x00,
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0x00,0x00,0x00,0x00,0x00
};
const uint8_t rook_bitmap7[] PROGMEM = {//해피콩 더워2 ㅠ
0x00,0x00,0x00,0x01,0xf8,
0x00,0x00,0x00,0x03,0x0c,
0x00,0x00,0x00,0x02,0x04,
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0x00,0x00,0x00,0x00,0x00
};
void Tree_state(){
  u8g_prepare2();
 
     if(light>360){//밤
        u8g.drawBitmapP( 95, 0, 4, 25, rook_bitmap2);
     }
      else
        u8g.drawBitmapP( 100, 0, 4, 25, rook_bitmap);
    
      u8g.drawStr( 0, 0, "Hum");
      u8g.setPrintPos(20,0);
      u8g.print(DHT.humidity);
      u8g.drawStr( 30, 0, "%");
      
      u8g.drawStr( 0, 10, "Temp");
      u8g.setPrintPos(20,10);
      u8g.print(DHT.temperature);
      u8g.drawStr( 30, 10, "C");
      
      if(DHT.temperature>27){
       u8g.drawStr( 0, 20, "Hot!!");
      }
      else if(DHT.temperature<25){
       u8g.drawStr( 0, 20, "Cold..");
      }
      else
        u8g.drawStr( 0, 20, "Happy..");
      if(count_cold>80)
            count_cold=0;
      if(DHT.temperature<25){
      if(count_cold<40)
         u8g.drawBitmapP( 40, 12, 5, 54, rook_bitmap4);
      else if(count_cold<80)
        u8g.drawBitmapP( 40, 12, 5, 54, rook_bitmap5);
        count_cold++;
      }
      else if(DHT.temperature>27)
        u8g.drawBitmapP( 40, 12, 5, 54, rook_bitmap7);
      else{
          if(count_happy>80)
               count_happy=0;
         if( count_happy<40)
              u8g.drawBitmapP( 40, 12, 5, 54, rook_bitmap3);
          else if(count_happy<80)
                    u8g.drawBitmapP( 40, 12, 5, 54, rook_bitmap6);
          count_happy++;
      }
      delay(10);
}
void draw_food(void) {
  u8g_prepare();
  switch(draw_state >> 3) {
    case 0: eat(); break;
    case 1: eat2(); break;
    case 2: eat3(); break;
  }
}
void eat(void){
     u8g.drawStr( 5, 20, "bin eat magnet");
}
void eat2(void){
     u8g.drawStr( 5, 20, "...........");
}
void eat3(void){
     u8g.drawStr( 5, 20, "almost done...");
}
void setup() {

   Serial.begin(9600);
   pinMode(inputPin, INPUT);     // declare pushbutton as input
  switch (chk){
    case DHTLIB_OK:  
                Serial.print("OK,\t"); 
                break;
    case DHTLIB_ERROR_CHECKSUM: 
                Serial.print("Checksum error,\t"); 
                break;
    case DHTLIB_ERROR_TIMEOUT: 
                Serial.print("Time out error,\t"); 
                break;
    default: 
                Serial.print("Unknown error,\t"); 
                break;
  }  
  u8g.setRot180();// rotate screen, if required
  //Serial.begin(9600);
    u8g.setContrast(0);
}

void loop() {  
//센서 인식 부분
chk = DHT.read(DHT11_PIN);
  light=analogRead(8);
  val = digitalRead(inputPin);  
//사진그래픽---------------------------------
if(val==HIGH){
  for(int i=0; i<24; i++){
    u8g.firstPage();  
  do {
    draw_food();
  } while( u8g.nextPage() );
  draw_state++;
  if ( draw_state >= 8*3 )
    draw_state = 0;
  }
  delay(150);

}
else{
if(action==0 ){//시작메뉴
    uiStep();                                // check for key press
  updateMenu();                            // update menu bar    
    u8g.firstPage();
    do  {
      drawMenu();
    } while( u8g.nextPage() );
  }
if(action==1&&menu_current==1){//첫번째 메뉴얼 실행
          uiStep();                               
        escape();
             u8g.firstPage();  
          do {
            print_menual();
  } while( u8g.nextPage() );
}
  
  if(action==1&&menu_current==2){//두번째 메뉴얼 실행
        uiStep();                              
        escape();
      u8g.firstPage();  
  do {
          Tree_state();
  } while( u8g.nextPage() );
  }
    if(action==1&&menu_current==3){//종료 메뉴얼 실행
        uiStep();                                // check for key press
        escape();
      u8g.firstPage();  
  do {
      u8g_prepare();
      u8g.drawStr( 10, 20, "thank you to play");
      
  } while( u8g.nextPage() );
  }
}
}
